## main/Kconfig.projbuild
```kconfig
menu "SIM FLOW Time Configuration"

    config SIM_FLOW_SNTP_SERVER
        string "SNTP Server"
        default "pool.ntp.org"
        help
            SNTP server to use for time synchronization.

    config SIM_FLOW_SNTP_RETRY_COUNT
        int "SNTP Max retry count"
        default 10
        help
            SNTP max retry count for time synchronization.


    config SIM_FLOW_SNTP_TIMEOUT
        int "SNTP Timeout"
        default 2000
        help
            SNTP timeout in milliseconds for time synchronization.

    config SIM_FLOW_TIME_DEFUALT_TIMEZONE
        string "defualt timezone"
        default "IST-2IDT"
        help
            SNTP timeout in milliseconds for time synchronization.

endmenu

menu "SIM FLOW Host Interface"

    config SIM_FLOW_HOST_INTERFACE_URI
        string "URI"
        default "pool.ntp.org"
        help
            Host address.

    config SIM_FLOW_HOST_INTERFACE_PORT
        int "Port"
        default 0
        help
            host port.

    config SIM_FLOW_HOST_INTERFACE_MQTT_KEEPALIVE
        int "KeepAlive"
        default 600
        help
            Keepalive in sec.


endmenu

menu "SIM BUILD"

    config SIM_FLOW_EMULATION_BUILD
        bool "Emulation build flag"
        default n
        help
            If enabled, build project for emulation.

endmenu
```
